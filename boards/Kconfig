## boards/shields/Kconfig
```kconfig
source "boards/shields/relic/Kconfig.shield"
source "boards/shields/relic/Kconfig.defconfig"
```

## boards/shields/relic/Kconfig.defconfig
```kconfig
if SHIELD_RELIC_LEFT

config ZMK_KEYBOARD_NAME
    default "relic"

config ZMK_SPLIT_ROLE_CENTRAL
    default y

endif # SHIELD_RELIC_LEFT

if SHIELD_RELIC_LEFT || SHIELD_RELIC_RIGHT

config ZMK_SPLIT
    default y

endif # SHIELD_RELIC_LEFT || SHIELD_RELIC_RIGHT
```

## boards/shields/relic/Kconfig.shield
```kconfig
config SHIELD_RELIC_LEFT
    def_bool $(shields_list_contains,relic_left)
  
config SHIELD_RELIC_RIGHT
    def_bool $(shields_list_contains,relic_right)
  
```
